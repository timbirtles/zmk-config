## config/Kconfig.nice_oled
```kconfig
config CUSTOM_WIDGET_NICE_OLED
    bool "Enable Nice OLED Widget"
    default y

config ZMK_WIDGETS
    bool "Enable ZMK widget framework"
    default y
```

## config/kconfig
```kconfig
rsource "../boards/shields/nice_oled/Kconfig.defconfig"
rsource "../zmk-nice-oled/Kconfig.nice_oled"
```
